## config/boards/shields/jaca_corne/Kconfig.defconfig
```kconfig
if SHIELD_JACA_CORNE_LEFT

config ZMK_KEYBOARD_NAME
    default "Jaca corne"

config ZMK_SPLIT_ROLE_CENTRAL
    default y

endif

if SHIELD_JACA_CORNE_RIGHT

config ZMK_KEYBOARD_NAME
    default "Jaca corne"

config ZMK_SPLIT_ROLE_CENTRAL
    default n

endif

if SHIELD_JACA_CORNE_LEFT || SHIELD_JACA_CORNE_RIGHT

config ZMK_SPLIT
    default y

endif
```

## config/boards/shields/jaca_corne/Kconfig.shield
```kconfig
config SHIELD_JACA_CORNE_LEFT
    def_bool $(shields_list_contains,jaca_corne_left)

config SHIELD_JACA_CORNE_RIGHT
    def_bool $(shields_list_contains,jaca_corne_right)
```
